## conf/layer.conf
```bitbake
# We have a conf and classes directory, append to BBPATH
BBPATH .= ":${LAYERDIR}"

# We have a recipes directory, add to BBFILES
BBFILES += "${LAYERDIR}/recipes*/*/*.bb ${LAYERDIR}/recipes*/*/*.bbappend"

BBFILE_COLLECTIONS += "meta-hipos-fsl"
BBFILE_PATTERN_meta-hipos-fsl := "^${LAYERDIR}/"
BBFILE_PRIORITY_meta-hipos-fsl = "15"
```

## conf/machine/dres0280_rev_a.conf
```bitbake
#@TYPE: Machine
#@NAME: DResearch dres0280
#@SOC: i.MX6Q
#@DESCRIPTION: Machine configuration for DResearch himx
#
#

include conf/machine/include/imx-base.inc
include conf/machine/include/tune-cortexa9.inc

SOC_FAMILY = "mx6:mx6q"

PREFERRED_PROVIDER_u-boot = "u-boot-himx"
PREFERRED_PROVIDER_virtual/bootloader = "u-boot-himx"
PREFERRED_PROVIDER_virtual/kernel = "linux-boundary"

# Use SPI NOR U-Boot by default
IMAGE_BOOTLOADER ?= ""

UBOOT_MACHINE = "dres0280_rev_a_config"

SERIAL_CONSOLE = "115200 ttymxc1"

MACHINE_FEATURES += " pci"
```

## conf/machine/himx.conf
```bitbake
#@TYPE: Machine
#@NAME: i.MX6 based DResearch HydraIP device family
#@SOC: i.MX6Q
#@DESCRIPTION: Machine configuration for i.MX6 based DResearch HydraIP device family

include conf/machine/include/imx-base.inc
include conf/machine/include/tune-cortexa9.inc

SOC_FAMILY = "mx6:mx6q"

PREFERRED_PROVIDER_u-boot = "u-boot-himx"
PREFERRED_PROVIDER_virtual/bootloader = "u-boot-himx"
PREFERRED_PROVIDER_virtual/kernel = "linux-boundary"

# Use SPI NOR U-Boot by default
IMAGE_BOOTLOADER ?= ""

UBOOT_MACHINE = "dres0280_rev_a_config"

SERIAL_CONSOLE = "115200 ttymxc1"

MACHINE_FEATURES += " pci"
```
